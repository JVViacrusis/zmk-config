## config/west.yml
```yaml
manifest:
  remotes:
    - name: JVViacrusis
      url-base: https://github.com/JVViacrusis
  projects:
    - name: zmk
      remote: JVViacrusis
      revision: cdc-mkb-zmk-mouse-pim447
      import: app/west.yml
  self:
    path: config
```
